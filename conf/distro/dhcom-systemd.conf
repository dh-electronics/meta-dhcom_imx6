## conf/distro/dhcom-systemd.conf
```bitbake
# FSLC Distro for FrameBuffer graphical backend.

require conf/distro/include/fslc-base.inc

DISTRO = "dhcom-systemd"
DISTRO_NAME = "DHCOM systemd"

DISTRO_FEATURES_append = " systemd sysvinit"
DISTRO_FEATURES_BACKFILL_CONSIDERED += "sysvinit"
VIRTUAL-RUNTIME_init_manager = "systemd"
VIRTUAL-RUNTIME_initscripts = "systemd-compat-units"
```

## conf/layer.conf
```bitbake
# Let bitbake find our .bbclass and .conf files
BBPATH .= ":${LAYERDIR}"

# Let bitbake know where to look for .bb and .bbappend files
BBFILES += "${LAYERDIR}/recipes-*/*/*.bb \
            ${LAYERDIR}/recipes-*/*/*.bbappend"

BBFILE_COLLECTIONS += "dhcom_imx6"
BBFILE_PATTERN_dhcom_imx6 := "^${LAYERDIR}/"
BBFILE_PRIORITY_dhcom_imx6 = "6"

LAYERDEPENDS_dhcom_imx6 = "core fsl-arm"
```

## conf/machine/dhcom2bimx6dl.conf
```bitbake
#@TYPE: Machine
#@NAME: DHCOM i.MX6 DualLite
#@SOC: i.MX6dl
#@DESCRIPTION: Machine configuration for DHCOM i.MX6 DualLite HW200

require conf/machine/include/dhcom_imx6-common.inc


SOC_FAMILY = "mx6:mx6dl"

KERNEL_DEVICETREE = "imx6dl-dhcom2B-pdk1.dtb"

do_rootfs[depends] += "imx6-dhcom-pdk1-ulinuxenvtxt:do_deploy"
```

## conf/machine/dhcom3bimx6q.conf
```bitbake
#@TYPE: Machine
#@NAME: DHCOM i.MX6 Quad
#@SOC: i.MX6Q
#@DESCRIPTION: Machine configuration for DHCOM i.MX6 Quad HW300

require conf/machine/include/dhcom_imx6-common.inc


SOC_FAMILY = "mx6:mx6q"

UBOOT_CONFIG ??= "q"
UBOOT_CONFIG[q] = "dh_imx6q_config"

KERNEL_DEVICETREE = "imx6q-dhcom3B-picoitx02.dtb"

do_rootfs[depends] += "imx6-dhcom-picoitx02-ulinuxenvtxt:do_deploy"
```

## conf/machine/dhcom4bimx6dl.conf
```bitbake
#@TYPE: Machine
#@NAME: DHCOM i.MX6 DualLite
#@SOC: i.MX6dl
#@DESCRIPTION: Machine configuration for DHCOM i.MX6 DualLite HW400

require conf/machine/include/dhcom_imx6-common.inc


SOC_FAMILY = "mx6:mx6dl"

UBOOT_CONFIG ??= "dl"
UBOOT_CONFIG[dl] = "dh_imx6dl_config"

KERNEL_DEVICETREE = "imx6dl-dhcom4B-picoitx02.dtb"

do_rootfs[depends] += "imx6-dhcom-picoitx02-ulinuxenvtxt:do_deploy"
```

## conf/machine/dhcom4bimx6q.conf
```bitbake
#@TYPE: Machine
#@NAME: DHCOM i.MX6 Quad
#@SOC: i.MX6S
#@DESCRIPTION: Machine configuration for DHCOM i.MX6 Quad PDK2 HW400

require conf/machine/include/dhcom_imx6-common.inc
include conf/machine/include/tune-cortexa9.inc

#SOC_FAMILY = "mx6:mx6q:"
MACHINEOVERRIDES =. "mx6:mx6q:"

UBOOT_CONFIG ??= "q"

KERNEL_DEVICETREE ?= "imx6q-dhcom4B-pdk2.dtb"
KERNEL_DEFCONFIG ?= "imx6_dhcom_defconfig"
PREFERRED_VERSION_linux-imx6-dhcom = "4.4.60"
GCCVERSION ?= "7.3.%"
PREFERRED_PROVIDER_u-boot ??= "${IMX_DEFAULT_BOOTLOADER}"


do_rootfs[depends] += "imx6-dhcom-pdk2-ulinuxenvtxt:do_deploy"
do_rootfs[depends] += "splash:do_deploy"
IMAGE_BOOT_FILES += "uLinuxEnv.txt 800x480_done.bmp 800x480_error.bmp 800x480_progress.bmp splash.bmp settings.bin"

WKS_FILE = "dhcom-uboot-bootpart.wks"
IMAGE_BOOTLOADER ?= "u-boot"
```

## conf/machine/dhcom4bimx6s.conf
```bitbake
#@TYPE: Machine
#@NAME: DHCOM i.MX6 Solo
#@SOC: i.MX6S
#@DESCRIPTION: Machine configuration for DHCOM i.MX6 Solo PDK2 HW400

require conf/machine/include/dhcom_imx6-common.inc
include conf/machine/include/tune-cortexa9.inc

#SOC_FAMILY = "mx6:mx6s:"
MACHINEOVERRIDES =. "mx6:mx6s:"

UBOOT_CONFIG ??= "solo"

KERNEL_DEVICETREE ?= "imx6s-dhcom4B-pdk2.dtb"
KERNEL_DEFCONFIG ?= "imx6_dhcom_defconfig"
PREFERRED_VERSION_linux-imx6-dhcom = "4.4.60"
GCCVERSION ?= "7.3.%"
PREFERRED_PROVIDER_u-boot ??= "${IMX_DEFAULT_BOOTLOADER}"


do_rootfs[depends] += "imx6-dhcom-pdk2-ulinuxenvtxt:do_deploy"
do_rootfs[depends] += "splash:do_deploy"
IMAGE_BOOT_FILES += "uLinuxEnv.txt 800x480_done.bmp 800x480_error.bmp 800x480_progress.bmp splash.bmp settings.bin"

WKS_FILE = "dhcom-uboot-bootpart.wks"
IMAGE_BOOTLOADER ?= "u-boot"
```

## conf/machine/dhcom_imx6dl.conf
```bitbake
#@TYPE: Machine
#@NAME: DHCOM i.MX6 Duallite
#@SOC: i.MX6dl
#@DESCRIPTION: Machine configuration for DHCOM i.MX6 Duallite

require conf/machine/include/imx-base.inc
require conf/machine/include/tune-cortexa9.inc

SOC_FAMILY = "mx6:mx6dl"

PREFERRED_PROVIDER_u-boot = "u-boot-imx6-dhcom"
PREFERRED_VERSION_u-boot-imx6-dhcom = "dhv0.4.2.2"
UBOOT_CONFIG ??= "dl"
UBOOT_CONFIG[dl] = "dh_imx6dl_config"
IMAGE_BOOTLOADER ?= "u-boot"
#do_rootfs[depends] += "bootscript:do_deploy"
do_rootfs[depends] += "imx6dl-ulinuxenvtxt:do_deploy"
do_rootfs[depends] += "splash:do_deploy"
do_rootfs[depends] += "settings:do_deploy"
BOOT_SCRIPTS += "uLinuxEnv.txt 800x480_done.bmp 800x480_error.bmp 800x480_progress.bmp splash.bmp settings.bin"

UBOOT_MAKE_TARGET = "u-boot.imx"
UBOOT_BINARY = "u-boot.imx"

# override boot partition size 50MB and volume-id
BOOT_SPACE = "51200"
BOOTDD_VOLUME_ID ?= "boot"

# Use linux kernel iMX6 dhcom
PREFERRED_PROVIDER_virtual/kernel = "linux-imx6-dhcom"
PREFERRED_VERSION_linux-imx = "3.10.17"
KERNEL_DEVICETREE = "imx6dl-dheva01.dtb imx6dl-dheva01-ldo.dtb"
KERNEL_IMAGETYPE = "zImage"

SERIAL_CONSOLE = "115200 ttymxc0"

MACHINE_FIRMWARE_append_mx6 = " linux-firmware-ath6k"
MACHINE_FEATURES += " pci wifi bluetooth"

#MACHINE_EXTRA_RRECOMMENDS_append = " kernel-modules"
```

## conf/machine/dhcom_imx6q.conf
```bitbake
#@TYPE: Machine
#@NAME: DHCOM i.MX6 Quad
#@SOC: i.MX6Q
#@DESCRIPTION: Machine configuration for DHCOM i.MX6 Quad

require conf/machine/include/imx-base.inc
require conf/machine/include/tune-cortexa9.inc

SOC_FAMILY = "mx6:mx6q"

PREFERRED_PROVIDER_u-boot = "u-boot-imx6-dhcom"
PREFERRED_VERSION_u-boot-imx6-dhcom = "dhv0.4.2.2"
UBOOT_CONFIG ??= "qd"
UBOOT_CONFIG[qd] = "dh_imx6q_d_config"
IMAGE_BOOTLOADER ?= "u-boot"
#do_rootfs[depends] += "dhcom_imx6-bootscript-sd:do_deploy"
do_rootfs[depends] += "dhcom_imx6-uLinuxEnvtxt:do_deploy"
do_rootfs[depends] += "dhcom_imx6-splash:do_deploy"
do_rootfs[depends] += "dhcom_imx6-settings:do_deploy"
#BOOT_SCRIPTS = "bootscript"

UBOOT_MAKE_TARGET = "u-boot.imx"
UBOOT_BINARY = "u-boot.imx"

# override boot partition size 50MB and volume-id
BOOT_SPACE = "51200"
BOOTDD_VOLUME_ID ?= "boot"

# Use linux kernel iMX6 dhcom
PREFERRED_PROVIDER_virtual/kernel = "linux-imx6-dhcom"
PREFERRED_VERSION_linux-imx = "3.10.17"
KERNEL_DEVICETREE = "imx6q-dheva01.dtb imx6q-dheva01-ldo.dtb"
KERNEL_IMAGETYPE = "zImage"

SERIAL_CONSOLE = "115200 ttymxc0"

MACHINE_FIRMWARE_append_mx6 = " linux-firmware-ath6k"
MACHINE_FEATURES += " pci wifi bluetooth"

#MACHINE_EXTRA_RRECOMMENDS_append = " kernel-modules"
```

## conf/machine/dhcom_imx6s.conf
```bitbake
#@TYPE: Machine
#@NAME: ArchiTech Tibidabo board
#@SOC: i.MX6Q
#@DESCRIPTION: Machine configuration for ArchiTech Tibidabo board

require conf/machine/include/imx-base.inc
require conf/machine/include/tune-cortexa9.inc

SOC_FAMILY = "mx6:mx6s"

PREFERRED_PROVIDER_u-boot = "u-boot-imx6-dhcom"
PREFERRED_VERSION_u-boot-imx6-dhcom = "dhv0.4.2.2"
UBOOT_CONFIG ??= "solo"
UBOOT_CONFIG[solo] = "dh_imx6s_config"
IMAGE_BOOTLOADER ?= "u-boot"
#do_rootfs[depends] += "dhcom_imx6-bootscript-sd:do_deploy"
do_rootfs[depends] += "dhcom_imx6-uLinuxEnvtxt:do_deploy"
do_rootfs[depends] += "dhcom_imx6-splash:do_deploy"
do_rootfs[depends] += "dhcom_imx6-settings:do_deploy"
#BOOT_SCRIPTS = "bootscript"

UBOOT_MAKE_TARGET = "u-boot.imx"
UBOOT_BINARY = "u-boot.imx"

# override boot partition size 50MB and volume-id
BOOT_SPACE = "51200"
BOOTDD_VOLUME_ID ?= "boot"

# Use linux kernel iMX6 dhcom
PREFERRED_PROVIDER_virtual/kernel = "linux-imx6-dhcom"
PREFERRED_VERSION_linux-imx = "3.10.17"
KERNEL_DEVICETREE = "imx6s-dheva01.dtb"
KERNEL_IMAGETYPE = "zImage"

SERIAL_CONSOLE = "115200 ttymxc0"

MACHINE_FIRMWARE_append_mx6 = " linux-firmware-ath6k"
MACHINE_FEATURES += " pci wifi bluetooth"

#MACHINE_EXTRA_RRECOMMENDS_append = " kernel-modules"
```

## conf/machine/include/dhcom_imx6-common.inc
```bitbake
# Provides the DHCOM i.MX6 common settings

require conf/machine/include/imx-base.inc
require conf/machine/include/tune-cortexa9.inc

PREFERRED_PROVIDER_virtual/bootloader = "u-boot-imx6-dhcom"
PREFERRED_PROVIDER_u-boot = "u-boot-imx6-dhcom"
PREFERRED_VERSION_u-boot-imx6-dhcom = "v2018.03"
IMAGE_BOOTLOADER ?= "u-boot"
#do_rootfs[depends] += "bootscript:do_deploy"
do_rootfs[depends] += "splash:do_deploy"
do_rootfs[depends] += "settings-13-fg0700g3dssw:do_deploy"
BOOT_SCRIPTS += "uLinuxEnv.txt 800x480_done.bmp 800x480_error.bmp 800x480_progress.bmp splash.bmp settings.bin"

UBOOT_CONFIG ??= "all"
UBOOT_CONFIG[all] = "dh_imx6_defconfig"
UBOOT_CONFIG[solo] = "dh_imx6s_config"
UBOOT_CONFIG[dl] = "dh_imx6dl_config"
UBOOT_CONFIG[d] = "dh_imx6q_config"
UBOOT_CONFIG[q] = "dh_imx6q_config"

UBOOT_MAKE_TARGET = "all"
UBOOT_BINARY = "u-boot-with-spl.imx"

# override boot partition size 50MB and volume-id
BOOT_SPACE = "51200"
BOOTDD_VOLUME_ID ?= "boot"

# Use linux kernel iMX6 dhcom
PREFERRED_PROVIDER_virtual/kernel = "linux-imx6-dhcom"
PREFERRED_VERSION_linux-imx6-dhcom = "4.1.15"
KERNEL_IMAGETYPE = "zImage"

SERIAL_CONSOLE = "115200 ttymxc0"

MACHINE_FIRMWARE_append_mx6 = " linux-firmware-ath6k"
MACHINE_FEATURES += " pci wifi bluetooth"

#MACHINE_EXTRA_RRECOMMENDS_append = " kernel-modules"

SOC_DEFAULT_IMAGE_FSTYPES = "tar.bz2 sdcard"
SDCARD_ROOTFS = "${DEPLOY_DIR_IMAGE}/${IMAGE_NAME}.rootfs.ext3"
```
